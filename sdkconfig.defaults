## sdkconfig.defaults
```kconfig
# ---- Target: original ESP32 (Xtensa LX6) ----
CONFIG_IDF_TARGET="esp32"

# ---- Arduino-as-component needs a 1 kHz tick and we drive app_main ourselves ----
CONFIG_FREERTOS_HZ=1000
CONFIG_AUTOSTART_ARDUINO=n
CONFIG_ESP_MAIN_TASK_STACK_SIZE=8192

# ---- BLE (Nordic UART Service) via the Arduino BLE library (Bluedroid) ----
CONFIG_BT_ENABLED=y
CONFIG_BT_BLUEDROID_ENABLED=y
CONFIG_BT_BLE_ENABLED=y
CONFIG_BT_CLASSIC_ENABLED=n

# ---- Wi-Fi + BLE + Arduino + Swift is large: custom 3 MB app partition ----
CONFIG_PARTITION_TABLE_CUSTOM=y
CONFIG_PARTITION_TABLE_CUSTOM_FILENAME="partitions.csv"

# ---- Size optimization (Embedded Swift is built -Osize) ----
CONFIG_COMPILER_OPTIMIZATION_SIZE=y

# ---- Let orphan Swift sections be placed instead of erroring ----
CONFIG_LINKER_ORPHAN_HANDLING_PLACE=y

# ---- Board has 4 MB flash (needed for the 3 MB app partition) ----
CONFIG_ESPTOOLPY_FLASHSIZE_4MB=y
CONFIG_ESPTOOLPY_FLASHSIZE="4MB"

# ---- HTTPS: Arduino's ssl_client.cpp compiles its body only when a PSK key
#      exchange is enabled (defines MBEDTLS_KEY_EXCHANGE_SOME_PSK_ENABLED);
#      otherwise WiFiClientSecure fails to link. Cert bundle validates certs. ----
CONFIG_MBEDTLS_PSK_MODES=y
CONFIG_MBEDTLS_KEY_EXCHANGE_PSK=y
CONFIG_MBEDTLS_CERTIFICATE_BUNDLE=y
CONFIG_MBEDTLS_CERTIFICATE_BUNDLE_DEFAULT_FULL=y
```
